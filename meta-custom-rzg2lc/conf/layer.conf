## meta-custom-rzg2lc/conf/layer.conf
```bitbake
# We have a conf and classes directory, add to BBPATH
BBPATH .= ":${LAYERDIR}"

# We have recipes-* directories, add to BBFILES
BBFILES += "${LAYERDIR}/recipes-*/*/*.bb \
            ${LAYERDIR}/recipes-*/*/*.bbappend"

BBFILE_COLLECTIONS += "meta-custom-rzg2lc"
BBFILE_PATTERN_meta-custom-rzg2lc = "^${LAYERDIR}/"
BBFILE_PRIORITY_meta-custom-rzg2lc = "6"

LAYERDEPENDS_meta-custom-rzg2lc = "rz-common"
LAYERSERIES_COMPAT_meta-custom-rzg2lc = "dunfell"
```
